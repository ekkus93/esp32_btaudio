## esp_bt_audio_source/build/defconfig
```kconfig
CONFIG_PARTITION_TABLE_CUSTOM=y
CONFIG_EXAMPLE_PEER_DEVICE_NAME=""
CONFIG_BT_ENABLED=y
CONFIG_BT_BTU_TASK_STACK_SIZE=6528
CONFIG_BT_BLUEDROID_MEM_DEBUG=y
CONFIG_BT_CLASSIC_ENABLED=y
CONFIG_BT_A2DP_ENABLE=y
CONFIG_BTDM_CTRL_MODE_BR_EDR_ONLY=y
CONFIG_ESP_SYSTEM_PANIC_PRINT_HALT=y
CONFIG_ESP_COREDUMP_ENABLE_TO_UART=y
CONFIG_FREERTOS_IDLE_TASK_STACKSIZE=2048
CONFIG_FREERTOS_TIMER_TASK_STACK_DEPTH=3072
```

## esp_bt_audio_source/main/Kconfig.projbuild
```kconfig
menu "A2DP Example Configuration"
    config EXAMPLE_SSP_ENABLED
        bool "Secure Simple Pairing"
        depends on BT_CLASSIC_ENABLED
        default y
        help
            This enables the Secure Simple Pairing. If disable this option,
            Bluedroid will only support Legacy Pairing

    config EXAMPLE_PEER_DEVICE_NAME
        string "Target Device Name"
        default "ESP_SPEAKER"
        help
            Use this option to set target device name to connect.

    config AUDIO_USE_SYNTH_SOURCE
        bool "Use synthetic audio source (no I2S)"
        default n
        help
            When enabled the audio processor will generate a synthetic
            audio waveform (sine) for development and testing instead of
            attempting to read from an I2S peripheral. This is useful
            when no physical I2S source is attached. Note: enabling this
            disables the normal I2S read path at build-time.

    menu "Audio Configuration Defaults"
        config AUDIO_DEFAULT_SAMPLE_RATE
            int "Default Audio Sample Rate (Hz)"
            default 48000
            range 8000 96000
            help
                Default sample rate for audio processing at boot.
                Common values: 48000 (professional/streaming), 44100 (CD quality),
                32000, 22050, 16000, 8000.
                Can be overridden at runtime via NVS or future commands.

        config AUDIO_DEFAULT_VOLUME
            int "Default Audio Volume (0-100)"
            default 80
            range 0 100
            help
                Default volume level for audio output at boot (0-100).
                0 = muted, 100 = maximum volume.
                Can be adjusted at runtime via VOLUME command.

        config AUDIO_DEFAULT_BIT_DEPTH
            int "Default Audio Bit Depth"
            default 16
            help
                Default bit depth for audio samples.
                Common values: 16 (standard), 24 (high quality), 32 (professional).
                Must match I2S source capabilities.

        config AUDIO_AUTOSTART_DEFAULT
            bool "Enable Audio Autostart by Default"
            default y
            help
                When enabled, audio processor initializes and starts automatically
                at boot. When disabled, audio init is deferred until explicitly
                requested via command or application logic.
                Runtime setting stored in NVS takes precedence if configured.

        config AUDIO_RB_CAPACITY_KB
            int "Ring Buffer Capacity (KB)"
            default 32
            range 8 256
            help
                Audio ring buffer capacity in kilobytes.
                Larger buffers provide more headroom against underruns but use more memory.
                32KB = 167ms @ 48kHz stereo 16-bit (192KB/s)
                128KB = 667ms buffer (requires PSRAM for this size)
                Recommended: 32KB (DRAM) or 128KB (PSRAM)

        config AUDIO_RB_USE_PSRAM
            bool "Use PSRAM for Ring Buffer"
            default n
            depends on SPIRAM
            help
                When enabled, allocate ring buffer in PSRAM instead of DRAM.
                Recommended for large buffers (>64KB) to conserve DRAM.
                Requires PSRAM to be enabled and available.
                Note: Ring buffer structure itself is always in DRAM (small overhead).
    endmenu

    menu "UART Audio Streaming (UARTAUDIO)"
        config UART_AUDIO_ENABLED
            bool "Enable UART audio streaming (laptop -> BT speaker dev path)"
            default y
            help
                Stream stereo 22050 Hz s16le PCM from a host PC over the
                console UART (UARTAUDIO command), upsampled 2x to 44100 Hz
                on device and played over A2DP. Development/test feature;
                see tools/stream_audio_uart.py for the host-side streamer.

        config UART_AUDIO_STREAM_BAUD
            int "Streaming baud rate"
            depends on UART_AUDIO_ENABLED
            default 921600
            range 230400 921600
            help
                UART baud rate during streaming mode. 921600 is required
                for stereo 22.05 kHz (88.2 KB/s payload); lower rates exist
                for troubleshooting flaky USB-serial bridges but cannot
                carry full stereo 22.05 kHz audio (a degraded mono mode is
                not implemented).

        config UART_AUDIO_STAGING_RB_KB
            int "Staging ring buffer size (KB)"
            depends on UART_AUDIO_ENABLED
            default 32
            range 8 64
            help
                DRAM staging buffer between the UART reader task and the
                audio engine. 32 KB buffers ~371 ms of 22.05 kHz input
                (prebuffer fires at 50%). Reduce to 16 KB if DRAM is tight.

        config UART_AUDIO_RX_BUF_BYTES
            int "UART driver RX buffer during streaming (bytes)"
            depends on UART_AUDIO_ENABLED
            default 8192
            range 2048 16384
            help
                Console UART driver RX buffer (installed once at boot).
                At ~92 KB/s wire rate, 8192 bytes tolerate ~89 ms of
                reader-task stall; the old 1024-byte default only ~11 ms.

        config UART_AUDIO_FEEDBACK_MS
            int "Fill-level feedback period (ms)"
            depends on UART_AUDIO_ENABLED
            default 250
            range 50 1000
            help
                Period of the UA|FILL feedback lines the device sends to
                the host during streaming so the host can trim its pacing.
    endmenu

    menu "Secondary Command UART"
        config CMD_UART2_ENABLED
            bool "Enable secondary command UART (UART2)"
            default y
            help
                Serve the text command protocol on a second UART in
                addition to the console/USB UART. Purely additive: the
                console UART keeps working unchanged (and remains the
                UARTAUDIO streaming transport). Responses return on the
                UART the command arrived on; EVENT lines broadcast to
                both. The secondary port also keeps serving commands
                while UARTAUDIO streaming owns the console UART.

        config CMD_UART2_RX_PIN
            int "Secondary UART RX pin"
            depends on CMD_UART2_ENABLED
            default 16
            help
                GPIO for UART2 RX (connect to your adapter's TX).
                Default 16 is free on WROOM-32 boards (do not use on
                WROVER: 16/17 are PSRAM).

        config CMD_UART2_TX_PIN
            int "Secondary UART TX pin"
            depends on CMD_UART2_ENABLED
            default 17
            help
                GPIO for UART2 TX (connect to your adapter's RX).

        config CMD_UART2_BAUD
            int "Secondary UART baud rate"
            depends on CMD_UART2_ENABLED
            default 115200
            range 9600 921600
    endmenu

    menu "Bluetooth Logging Configuration"
        config BT_VERBOSE_AUDIO_LOGGING
            bool "Enable Verbose Audio Logging (Development Only)"
            default n
            help
                WARNING: Enabling this option can cause audio glitches!
                
                When enabled, logs detailed audio data callback events including:
                - Audio processor read errors
                - Buffer underruns with byte counts
                - Underrun rate statistics
                
                This is a BLOCKING I/O operation that can exceed the 2.9ms 
                audio frame deadline at 44.1kHz, causing audio glitches.
                
                Only enable for development/debugging. NEVER enable in production.
                
                Recommended: Keep DISABLED (default) for normal operation.
    endmenu
endmenu
```

## esp_bt_audio_source/test/test_app3/Kconfig.projbuild
```kconfig
menu "test_app3 options"

comment "Moved options"
	comment "See components/audio_test/Kconfig.projbuild for option definitions"

endmenu
```

## esp_bt_audio_source/test/test_app3/sdkconfig.defaults
```kconfig
# Test-only defaults for test_app3
CONFIG_BT_MOCK_TESTING=y
# Optionally enable verbose diagnostics for tag tests
CONFIG_AUDIO_TAG_DIAGNOSTICS=y

# Lower log level noise for tests
CONFIG_LOG_DEFAULT_LEVEL_NONE=y

# Enable IDF test runner integration so `idf.py test` discovers Unity tests
CONFIG_UNITY_ENABLE_IDF_TEST_RUNNER=y
```

## esp_bt_audio_source/test/test_app_audio/sdkconfig.defaults
```kconfig
# Enable SPIRAM (PSRAM) for test runs so PSRAM allocations are exercised.
CONFIG_SPIRAM=n
# Enable mock hooks so test-only helpers (beep fallback, tag counters, etc.) are compiled for device tests.
CONFIG_BT_MOCK_TESTING=y
# Choose a reasonable default speed/mode — keep minimal to avoid platform-specific issues.
# These can be adjusted per-board if needed.
#CONFIG_SPIRAM_SPEED_80M=y
#CONFIG_SPIRAM_MODE_OCT=y
CONFIG_ESP_MAIN_TASK_STACK_SIZE=8192
CONFIG_UNITY_FREERTOS_STACK_SIZE=8192
CONFIG_FREERTOS_WATCHPOINT_END_OF_STACK=y
CONFIG_UNITY_ENABLE_FLOAT=y
CONFIG_UNITY_ENABLE_DOUBLE=y
CONFIG_UNITY_ENABLE_IDF_TEST_RUNNER=y
CONFIG_ESP_TASK_WDT_TIMEOUT_S=10

## Enable custom partition table so the test app uses the repository partitions.csv (needed for SPIFFS)
## Disable single-app partition table and enable custom partition table
# (Kconfig choice: only one partition table option may be selected)
# Disable single-app partition table
# CONFIG_PARTITION_TABLE_SINGLE_APP is not set
CONFIG_PARTITION_TABLE_CUSTOM=y
CONFIG_PARTITION_TABLE_CUSTOM_FILENAME="../../partitions.csv"
```

## esp_bt_audio_source/test/test_manager/sdkconfig.defaults
```kconfig
# Test suite configuration for test_manager
CONFIG_FREERTOS_HZ=1000
CONFIG_ESP_TASK_WDT_TIMEOUT_S=10
CONFIG_UNITY_ENABLE_DOUBLE=y
CONFIG_UNITY_ENABLE_FLOAT=y
```

## esp_bt_audio_source/test_app/sdkconfig.defaults
```kconfig
CONFIG_ESP_MAIN_TASK_STACK_SIZE=8192
CONFIG_UNITY_FREERTOS_STACK_SIZE=8192
CONFIG_FREERTOS_WATCHPOINT_END_OF_STACK=y
# Use the correct Kconfig symbol for Unity
CONFIG_UNITY_ENABLE_FLOAT=y
CONFIG_UNITY_ENABLE_DOUBLE=y
CONFIG_UNITY_ENABLE_IDF_TEST_RUNNER=y
CONFIG_ESP_TASK_WDT_TIMEOUT_S=10
```

## esp_bt_audio_source/test_app3/components/audio_test/Kconfig.projbuild
```kconfig
menu "Audio test options"

config BT_MOCK_TESTING
    bool "Enable BT mock/testing hooks"
    default y
    help
      Enable test-only audio tag helpers.

config AUDIO_TAG_DIAGNOSTICS
    bool "Enable audio tag diagnostics"
    default y
    help
      Emit extra diagnostics around tag buffering during tests.

endmenu
```

## esp_bt_audio_source/test_app_audio/Kconfig
```kconfig
# Kconfig for test_app_audio

config TEST_APP_AUDIO_PSRAM_TESTS
    bool "Enable on-device PSRAM integration tests"
    default SPIRAM
    help
      Enable the PSRAM integration tests which exercise heap_caps and
      audio_processor allocations that prefer PSRAM. This option defaults to
      the value of SPIRAM (enabled when SPIRAM is enabled in project config).

      If disabled, the PSRAM integration tests will be skipped and the
      test runner will print a clear skip message.
```

## esp_bt_audio_source/test_app_audio/sdkconfig.defaults
```kconfig
CONFIG_ESP_MAIN_TASK_STACK_SIZE=8192
CONFIG_UNITY_FREERTOS_STACK_SIZE=8192
CONFIG_FREERTOS_WATCHPOINT_END_OF_STACK=y
CONFIG_UNITY_ENABLE_FLOAT=y
CONFIG_UNITY_ENABLE_DOUBLE=y
CONFIG_UNITY_ENABLE_IDF_TEST_RUNNER=y
CONFIG_ESP_TASK_WDT_TIMEOUT_S=10

## Enable custom partition table so the test app uses the repository partitions.csv (needed for SPIFFS)
## Disable single-app partition table and enable custom partition table
# (Kconfig choice: only one partition table option may be selected)
# Disable single-app partition table
# CONFIG_PARTITION_TABLE_SINGLE_APP is not set
CONFIG_PARTITION_TABLE_CUSTOM=y
CONFIG_PARTITION_TABLE_CUSTOM_FILENAME="partitions.csv"
```

## esp_i2s_source/main/Kconfig.projbuild
```kconfig
menu "ESP I2S Source"

config ESP_I2S_SOURCE_ALLOW_LOCAL_STREAMS
    bool "Allow radio streams to local/private network addresses"
    default n
    help
        Development-only override. When disabled, radio URLs, DNS results,
        redirects, and reconnects reject loopback, link-local, private,
        multicast, unspecified, and broadcast destinations.

config ESP_I2S_SOURCE_STA_HEX_PSK
    bool "Allow 64-character hexadecimal STA PSKs"
    default n
    help
        Permit an exact 64-hex-character raw WPA PSK. Non-hex 64-character
        values remain invalid and are never truncated.

endmenu
```

## esp_i2s_source/sdkconfig.defaults
```kconfig
# esp_i2s_source defaults — ESP32-S3-WROOM-1 N16R8 (16 MB flash, 8 MB octal PSRAM)
# See docs/SPEC.md §2 (locked decisions) and §6 (memory budget).

# --- Target ---
CONFIG_IDF_TARGET="esp32s3"

# --- Flash: 16 MB ---
CONFIG_ESPTOOLPY_FLASHSIZE_16MB=y
CONFIG_ESPTOOLPY_FLASHSIZE="16MB"

# --- Octal PSRAM (N16R8 = 8 MB, octal mode) ---
CONFIG_SPIRAM=y
CONFIG_SPIRAM_MODE_OCT=y
CONFIG_SPIRAM_SPEED_80M=y

# --- Console on native USB-Serial-JTAG ---
# The devkit is connected via its USB port (/dev/ttyACM0), so route the
# console there rather than UART0. Revisit if the CP2102 UART port is used.
CONFIG_ESP_CONSOLE_USB_SERIAL_JTAG=y

# --- HTTP server WebSocket support (web_ui, WEB-1) ---
CONFIG_HTTPD_WS_SUPPORT=y

# --- Partition table: bigger app for TLS + decoders; larger NVS for presets ---
# (RADIO-1b) Default single-app ~1 MB is too small once esp_http_client +
# esp-tls + the mbedtls cert bundle link in. See partitions.csv.
CONFIG_PARTITION_TABLE_CUSTOM=y
CONFIG_PARTITION_TABLE_CUSTOM_FILENAME="partitions.csv"
```

## esp_i2s_source/test/test_device/sdkconfig.defaults
```kconfig
# Device test defaults for ESP32-S3
CONFIG_IDF_TARGET="esp32s3"

# Console on native USB-Serial-JTAG (same as main project)
CONFIG_ESP_CONSOLE_USB_SERIAL_JTAG=y
# Disable UART as primary console
# CONFIG_ESP_CONSOLE_UART_DEFAULT is not set
# CONFIG_ESP_CONSOLE_UART_CUSTOM is not set
```

## esp_i2s_source/test/wifi_simple/sdkconfig.defaults
```kconfig
# ESP32-S3-WROOM-1 N16R8 hardware identity.
CONFIG_IDF_TARGET="esp32s3"

# Match the physical module flash size.
CONFIG_ESPTOOLPY_FLASHSIZE_16MB=y
CONFIG_ESPTOOLPY_FLASHSIZE="16MB"

# Native USB Serial/JTAG console.
CONFIG_ESP_CONSOLE_USB_SERIAL_JTAG=y

# Deliberately do not enable external PSRAM.

# Reuse the production partition layout so the diagnostic application is
# flashed at 0x20000 and does not overwrite the production NVS region.
CONFIG_PARTITION_TABLE_CUSTOM=y
CONFIG_PARTITION_TABLE_CUSTOM_FILENAME="../../partitions.csv"
```

## sdkconfig.defaults
```kconfig
CONFIG_BT_ENABLED=y
CONFIG_BT_BLUEDROID_ENABLED=y 
CONFIG_BT_CLASSIC_ENABLED=y
CONFIG_BT_A2DP_ENABLE=y
CONFIG_BT_SPP_ENABLED=y
CONFIG_BT_BLE_ENABLED=n
CONFIG_BT_NIMBLE_ENABLED=n
CONFIG_FREERTOS_ENABLE_BACKWARD_COMPATIBILITY=y
```
